## conf/layer.conf
```bitbake
# We might have a conf and classes directory, append to BBPATH
BBPATH .= ":${LAYERDIR}"

# We have a recipes directory, add to BBFILES
BBFILES += "${LAYERDIR}/recipes*/*/*.bb ${LAYERDIR}/recipes*/*/*.bbappend"

BBFILE_COLLECTIONS += "meta-hy"
BBFILE_PATTERN_meta-hy := "^${LAYERDIR}/"
BBFILE_PRIORITY_meta-hy = "10"
LAYERSERIES_COMPAT_meta-himvis = "sumo"
```
